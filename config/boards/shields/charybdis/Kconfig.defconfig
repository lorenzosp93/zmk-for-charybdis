## config/boards/shields/charybdis/Kconfig.defconfig
```kconfig
if SHIELD_CHARYBDIS_DONGLE

config ZMK_KEYBOARD_NAME
	default "Charybdis"

config ZMK_SPLIT_ROLE_CENTRAL
	default y

config ZMK_SPLIT_BLE_CENTRAL_PERIPHERALS
	default 2

endif

if SHIELD_CHARYBDIS_LEFT || SHIELD_CHARYBDIS_RIGHT || SHIELD_CHARYBDIS_DONGLE

config ZMK_SPLIT
	default y

endif
```

## config/west.yml
```yaml
manifest:
  remotes:
    - name: zmkfirmware
      url-base: https://github.com/zmkfirmware
    - name: inorichi
      url-base: https://github.com/inorichi
    - name: mctechnology17
      url-base: https://github.com/mctechnology17
    - name: carrefinho
      url-base: https://github.com/carrefinho
  projects:
    - name: zmk
      remote: zmkfirmware
      revision: v0.3
      import: app/west.yml
    - name: zmk-pmw3610-driver
      remote: inorichi
      revision: 1d9c2c68ca76012e1b1e5f6ef02fa5eadc4ca399
      
    - name: zmk-switch-layer
      remote: mctechnology17
      revision: 18320c2c7450dd807fe0ca531c9422a5c4547028

    - name: prospector-zmk-module
      remote: carrefinho
      revision: 77a852293532879c992847e01db27abe4f94fa9f

  self:
    path: config
```

## modules/prospector/dts/bindings/behaviors/charybdis,behavior-brightness-step.yaml
```yaml
description: Step Prospector backlight brightness
compatible: "charybdis,behavior-brightness-step"
include: one_param.yaml
```

## modules/prospector/dts/bindings/behaviors/charybdis,behavior-dpi-step.yaml
```yaml
description: Step normal pointer sensitivity on the Prospector
compatible: "charybdis,behavior-dpi-step"
include: one_param.yaml
```

## modules/prospector/dts/bindings/behaviors/charybdis,behavior-precision-step.yaml
```yaml
description: Step precision DPI
compatible: "charybdis,behavior-precision-step"
include: one_param.yaml
```

## modules/prospector/dts/bindings/input_processors/charybdis,input-processor-dpi.yaml
```yaml
description: Scale pointer movement using the current effective DPI
compatible: "charybdis,input-processor-dpi"
include: ip_zero_param.yaml
```
